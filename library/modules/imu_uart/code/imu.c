/**
 * imu.c — MSPM0-IMU 陀螺仪驱动（新器件）
 *
 * 通信协议：UART 115200, 9字节帧, CRC16校验
 * 帧格式：  0A 03 04 [angle_H] [angle_L] [dps_H] [dps_L] [CRC_L] [CRC_H]
 * 角度：    raw × 0.1 = °
 * 角速度：  raw × 0.1 = °/s
 *
 * 依赖：ti_msp_dl_config.h (UART IMU601, PA28/PA31)
 *
 * API 摘要：
 *   IMU_Init()              — 使能 UART 接收中断
 *   IMU_ConfigReportRate()  — 配置 IMU 报告频率
 *   IMU_ParseFrame(byte)    — 逐字节解析（由 ISR 调用）
 *
 * 全局变量（中断更新）：
 *   gyro_rx_done               — 收到完整帧时置 1（用户清零）
 *   gyro_angle_raw             — Yaw 角度 raw 值
 *   gyro_dps_raw               — 角速度 raw 值
 *   current_attitude           — 兼容旧代码的浮点姿态
 */

#include "imu.h"
#include "delay.h"

// ==================== 全局变量 ====================
volatile uint8_t gyro_rx_done = 0;
volatile int16_t gyro_angle_raw = 0;
volatile int16_t gyro_dps_raw = 0;

Attitude_t current_attitude = {0.0f, 0.0f, 0.0f};

// ==================== CRC16 查表（Modbus） ====================
static const uint8_t crc_hi_table[256] = {
    0x00, 0xC1, 0x81, 0x40, 0x01, 0xC0, 0x80, 0x41, 0x01, 0xC0, 0x80, 0x41,
    0x00, 0xC1, 0x81, 0x40, 0x01, 0xC0, 0x80, 0x41, 0x00, 0xC1, 0x81, 0x40,
    0x00, 0xC1, 0x81, 0x40, 0x01, 0xC0, 0x80, 0x41, 0x01, 0xC0, 0x80, 0x41,
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    0x00, 0xC1, 0x81, 0x40
};

static const uint8_t crc_lo_table[256] = {
    0x00, 0xC0, 0xC1, 0x01, 0xC3, 0x03, 0x02, 0xC2, 0xC6, 0x06, 0x07, 0xC7,
    0x05, 0xC5, 0xC4, 0x04, 0xCC, 0x0C, 0x0D, 0xCD, 0x0F, 0xCF, 0xCE, 0x0E,
    0x0A, 0xCA, 0xCB, 0x0B, 0xC9, 0x09, 0x08, 0xC8, 0xD8, 0x18, 0x19, 0xD9,
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    0x41, 0x81, 0x80, 0x40
};

static uint16_t CRC16(uint8_t *buf, uint16_t len)
{
    uint8_t crc_hi = 0xFF;
    uint8_t crc_lo = 0xFF;
    uint16_t idx;
    while (len--) {
        idx = crc_lo ^ *buf++;
        crc_lo = crc_hi ^ crc_hi_table[idx];
        crc_hi = crc_lo_table[idx];
    }
    return ((uint16_t)crc_hi << 8) | crc_lo;
}

// ==================== 帧解析状态机 ====================
// 帧格式：0A 03 04 [angle_H] [angle_L] [dps_H] [dps_L] [CRC_L] [CRC_H]
// 共 9 字节，CRC 校验前 7 字节
//
// 噪声过滤策略：字节间隙检测
//   真实 IMU 帧在 115200 波特率下，9 字节在 ~0.8ms 内连续到达（每字节 ~87μs）
//   噪声毛刺是孤立的，间隔远大于 10ms
//   利用这个时间差：帧内字节间隙 > 10ms → 之前的"帧"是噪声 → 丢弃
volatile uint16_t gyro_frame_timeout = 0;  // 由 10ms 定时器 ISR 递增

void IMU_ParseFrame(uint8_t data)
{
    static uint8_t state = 0;
    static uint8_t frame[9];
    static uint8_t idx = 0;
    uint16_t crc_calc, crc_recv;

    // ===== 间隙检测：过滤毛刺噪声 =====
    // 如果距离上一个字节已经过去了 >10ms，且当前不在空闲状态(state 0)
    // 说明之前的字节序列不是连续的真帧 → 丢弃，重新开始
    if (gyro_frame_timeout > 0 && state != 0) {
        state = 0;
        idx = 0;
    }
    gyro_frame_timeout = 0;  // 收到字节，清零间隙计时，开始新一轮计时

    switch (state) {
    case 0:  // 空闲：等待帧头 0x0A
        if (data == 0x0A) {
            idx = 0;
            frame[idx++] = data;
            state = 1;
        }
        // 不是 0x0A → 保持 state 0，直接丢弃（包括噪声字节）
        break;

    case 1:  // 等待 0x03
        if (data == 0x03) {
            frame[idx++] = data;
            state = 2;
        } else {
            state = 0;  // 不匹配 → 之前那个 0x0A 是噪声
        }
        break;

    case 2:  // 等待 0x04（= 数据长度 4 字节）
        if (data == 0x04) {
            frame[idx++] = data;
            state = 3;
        } else {
            state = 0;
        }
        break;

    case 3:  // 接收剩余 6 字节（angle_H, angle_L, dps_H, dps_L, CRC_L, CRC_H）
        frame[idx++] = data;
        if (idx >= 9) {
            crc_calc = CRC16(frame, 7);
            crc_recv = frame[7] | ((uint16_t)frame[8] << 8);

            if (crc_calc == crc_recv) {
                gyro_angle_raw = (int16_t)(
                    ((uint16_t)frame[3] << 8) | frame[4]);
                gyro_dps_raw = (int16_t)(
                    ((uint16_t)frame[5] << 8) | frame[6]);

                // 更新兼容旧代码的 current_attitude（仅 yaw 有效）
                current_attitude.yaw   = (float)gyro_angle_raw * 0.1f;
                current_attitude.pitch = 0.0f;
                current_attitude.roll  = 0.0f;

                gyro_rx_done = 1;
            }
            // CRC 失败也回 state 0，不保留任何状态
            state = 0;
        }
        break;

    default:
        state = 0;
        break;
    }
}

// ==================== 配置 IMU 报告频率 ====================
// 发送 Modbus 写寄存器命令：AA 06 01 01 01 [CRC_L] [CRC_H]
// CRC16(AA 06 01 01 01) = 0x00AD（已通过标准 Modbus 算法验证）
void IMU_ConfigReportRate(void)
{
    // 命令帧：AA 06 01 01 01 AD 00
    static const uint8_t cmd[] = {0xAA, 0x06, 0x01, 0x01, 0x01, 0xAD, 0x00};

    for (uint8_t i = 0; i < sizeof(cmd); i++) {
        while (DL_UART_isBusy(IMU601_INST));
        DL_UART_Main_transmitData(IMU601_INST, cmd[i]);
    }
}

// 连续发送 n 次配置命令（间隔 interval_ms），提高送达率
void IMU_ConfigReportRateBurst(uint8_t count, uint32_t interval_ms)
{
    for (uint8_t i = 0; i < count; i++) {
        IMU_ConfigReportRate();
        if (i < count - 1) {
            delay_ms(interval_ms);
        }
    }
}

// ==================== RX FIFO 冲洗 ====================
// 清空 UART RX FIFO 中的残留数据（噪声字节），确保状态机从干净状态开始
void IMU_FlushRX(void)
{
    // 短暂延时让可能正在传输的字节完成
    delay_ms(1);
    // 读空 RX FIFO（最大深度 8 字节，多读几次确保清空）
    for (uint8_t i = 0; i < 16; i++) {
        (void)DL_UART_Main_receiveData(IMU601_INST);
    }
}

// ==================== 状态机手动重置 ====================
// 由外部调用（如重试前），确保解析器从 state 0 开始
void IMU_ResetParser(void)
{
    // 通过在 ISR 上下文外重置无法直接访问 static 变量，
    // 利用 gyro_frame_timeout 机制：设置一个很大的值，
    // 下一个收到的字节会触发间隙检测 → 自动重置到 state 0
    gyro_frame_timeout = 100;
    gyro_rx_done = 0;
}

// ==================== 初始化 ====================
void IMU_Init(void)
{
    IMU_FlushRX();  // 先清空 FIFO，再开中断
    NVIC_ClearPendingIRQ(IMU601_INST_INT_IRQN);
    NVIC_EnableIRQ(IMU601_INST_INT_IRQN);
}

// ==================== UART 接收中断 ====================
void IMU601_INST_IRQHandler(void)
{
    switch (DL_UART_getPendingInterrupt(IMU601_INST)) {
    case DL_UART_IIDX_RX:
        IMU_ParseFrame(DL_UART_receiveData(IMU601_INST));
        break;
    default:
        break;
    }
}
