/**
 * @cliArgs --device "MSPM0G350X" --package "LQFP-64(PM)" --part "Default" --product "mspm0_sdk@2.00.01.00"
 * @versions {"tool":"1.20.0+3587"}
 */

/**
 * Import the modules used in this configuration.
 */
const GPIO   = scripting.addModule("/ti/driverlib/GPIO", {}, false);
const GPIO1  = GPIO.addInstance();
const GPIO2  = GPIO.addInstance();
const SYSCTL = scripting.addModule("/ti/driverlib/SYSCTL");
const UART   = scripting.addModule("/ti/driverlib/UART", {}, false);
const UART1  = UART.addInstance();

/**
 * Write custom configuration values to the imported modules.
 */
GPIO1.$name                         = "GPIO_GRP_LED";
GPIO1.port                          = "PORTA";
GPIO1.portSegment                   = "Lower";
GPIO1.associatedPins.create(2);
GPIO1.associatedPins[0].assignedPin = "7";
GPIO1.associatedPins[0].$name       = "PIN_LED1";
GPIO1.associatedPins[1].assignedPin = "10";
GPIO1.associatedPins[1].$name       = "PIN_LED2";

const Board = scripting.addModule("/ti/driverlib/Board", {}, false);

GPIO2.$name                                 = "GPIO_GRP_KEY";
GPIO2.port                                  = "PORTB";
GPIO2.associatedPins.create(2);
GPIO2.associatedPins[0].$name               = "PIN_KEY1";
GPIO2.associatedPins[0].assignedPin         = "15";
GPIO2.associatedPins[0].direction           = "INPUT";
GPIO2.associatedPins[0].assignedPortSegment = "Lower";
GPIO2.associatedPins[0].interruptEn         = true;
GPIO2.associatedPins[0].polarity            = "RISE_FALL";
GPIO2.associatedPins[0].internalResistor    = "PULL_UP";
GPIO2.associatedPins[1].$name               = "PIN_KEY2";
GPIO2.associatedPins[1].direction           = "INPUT";
GPIO2.associatedPins[1].assignedPin         = "16";
GPIO2.associatedPins[1].assignedPortSegment = "Upper";
GPIO2.associatedPins[1].internalResistor    = "PULL_UP";
GPIO2.associatedPins[1].interruptEn         = true;
GPIO2.associatedPins[1].polarity            = "RISE";

SYSCTL.forceDefaultClkConfig = true;

UART1.enableFIFO                       = true;
UART1.$name                            = "UART_2";
UART1.peripheral.$assign               = "UART2";
UART1.txPinConfig.$name                = "ti_driverlib_gpio_GPIOPinGeneric0";
UART1.txPinConfig.direction            = scripting.forceWrite("OUTPUT");
UART1.txPinConfig.hideOutputInversion  = scripting.forceWrite(false);
UART1.txPinConfig.onlyInternalResistor = scripting.forceWrite(false);
UART1.txPinConfig.passedPeripheralType = scripting.forceWrite("Digital");
UART1.rxPinConfig.$name                = "ti_driverlib_gpio_GPIOPinGeneric1";
UART1.rxPinConfig.hideOutputInversion  = scripting.forceWrite(false);
UART1.rxPinConfig.onlyInternalResistor = scripting.forceWrite(false);
UART1.rxPinConfig.passedPeripheralType = scripting.forceWrite("Digital");

/**
 * Pinmux solution for unlocked pins/peripherals. This ensures that minor changes to the automatic solver in a future
 * version of the tool will not impact the pinmux you originally saw.  These lines can be completely deleted in order to
 * re-solve from scratch.
 */
GPIO1.associatedPins[0].pin.$suggestSolution = "PA7";
GPIO1.associatedPins[1].pin.$suggestSolution = "PA10";
Board.peripheral.$suggestSolution            = "DEBUGSS";
Board.peripheral.swclkPin.$suggestSolution   = "PA20";
Board.peripheral.swdioPin.$suggestSolution   = "PA19";
GPIO2.associatedPins[0].pin.$suggestSolution = "PB15";
GPIO2.associatedPins[1].pin.$suggestSolution = "PB16";
SYSCTL.peripheral.$suggestSolution           = "SYSCTL";
UART1.peripheral.rxPin.$suggestSolution      = "PA22";
UART1.peripheral.txPin.$suggestSolution      = "PA21";
